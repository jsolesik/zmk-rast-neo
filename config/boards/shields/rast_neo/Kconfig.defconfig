## config/boards/shields/rast_neo/Kconfig.defconfig
```kconfig
# Copyright (c) 2020 The ZMK Contributors
# SPDX-License-Identifier: MIT

config ZMK_BLE
	default y

config ZMK_USB
	default y

config ZMK_KEYBOARD_NAME
	default "RAST:NEO"

config ZMK_SPLIT
	default y

#config ZMK_SPLIT_BLE_ROLE_CENTRAL
#	default y
```

## config/boards/shields/rast_neo/Kconfig.shield
```kconfig
# Copyright (c) 2020 The ZMK Contributors
# SPDX-License-Identifier: MIT

config SHIELD_RAST_NEO_LEFT
	def_bool $(shields_list_contains,rast_neo_left)

config SHIELD_RAST_NEO_RIGHT
	def_bool $(shields_list_contains,rast_neo_right)
```
